/*!
 *     COPYRIGHT NOTICE
 *     Copyright (c) 2013,山外科技
 *     All rights reserved.
 *     技术讨论：山外论坛 http://www.vcan123.com
 *
 *     除注明出处外，以下所有内容版权均属山外科技所有，未经允许，不得用于商业用途，
 *     修改内容时必须保留山外科技的版权声明。
 *
 * @file       main.c
 * @brief      山外K60 平台主程序
 * @author     山外科技
 * @version    v5.0
 * @date       2013-08-28
 */

#include "common.h"
#include "include.h"
#include "PID.h"


      
//#define CAMERA_ON

uint8 imgbuff[CAMERA_SIZE];                             //定义存储接收图像的数组
//uint8 img[CAMERA_H][CAMERA_W];
uint8 img[CAMERA_H*CAMERA_W];//解压后的二值化图像


//中断函数声明
void PORTA_IRQHandler();
void DMA0_IRQHandler();
void PIT0_IRQHandler();//定时器PIT0中断服务函数
extern void SysTick_IRQHandler(void);

//自定义函数声明
void ImageAnalyze();//图像处理程序
void SpeedControl();//速度控制程序
void MotorInit();//电机PWM模块初始化
void MotorPower();//电机功率控制程序
void Motor2Power();//电机2功率控制程序
void ServMotorInit();//舵机PWM初始化
void set_serv(void);//控制舵机输出
void Turn();//舵机转角控制程序
void EncoderInit();//编码器初始化
void BuzzerInit();//蜂鸣器初始化
void Buzzer();//蜂鸣器控制程序

//全局变量定义
int PITirqCount=0,PIT1irqCount;//计时器中断累计标志
int imgCount=0;//帧数累计标志
int BuzzerCount=0;//蜂鸣器发声时间，单位为ms
uint16 ServoPulse=1370;//舵机输出高电平时间，范围0-3000us，原理为输出高电平并用PIT1产生该值对应定时，定时结束转为低电平，PIT0定时20ms重新输出

int Speed=0;//保存速度的变量
int Speed2=0;//保存速度的变量
int stopspeed=0;
int16 set_speed=0;//测试电机用

int TurnTest=0;
int TestSpeed=0;
float TurnP=5.5;
float TurnD=0;

int TurnError=0;
double TurnAngle = 0;
int motordiff = 0;

int Var1[5];
int Var2[5];
int Var3[5];
int Var4[5];

//PID定义
    float kp = 0.15;                   //比例系数
    float ki = 1.0;                   //积分系数
    float kd = 0.0;                   //微分系数
    float kc = 200;                   //积分门限
    
    double lastError = 0;           //Error[-1]
    double prevError = 0;           //Error[-2]
	float kFar=0;//远处的曲率结果
	float kNear=0;
	int mpower; //电机功率
	int setpower = 0;
	int setpower2 = 0;
	
	int var1,var2,var3,var4=0;
	int StopFlag=0;
	int T=0;
        int circle=0;
	
struct PID SpeedPid;
struct PID SpeedPid2;
	
//计时标志位
uint8 TimeFlag1ms=0;
uint8 TimeFlag10ms=0;
uint8 TimeFlag20ms=0;
uint8 TimeFlag50ms=0;
uint8 TimeFlag100ms=0;
uint8 TimeFlag1S=0;
int TimeUsed=0;

//显示坐标变量定义
Site_t site     = {0, 0};                           //显示图像左上角位置
Size_t imgsize  = {CAMERA_W, CAMERA_H};             //图像大小
Size_t size     = {CAMERA_W, CAMERA_H};             //显示区域图像大小  
Site_t strSite  = {81,0};                              //显示字符串的位置

sys_con system_config=0;

void get_system_config(void)
{
  uint8 sw_sta=0;
  sw_sta=get_sw_status();
   if((sw_sta&0x01)!=0)//BM1拨上去，使用摄像头
     system_config.camera=1;
   if((sw_sta&0x02)!=0)//BM2拨上去，使用LCD显示图像
     system_config.lcd=1;
   if((sw_sta&0x04)!=0)//BM3拨上去，使用串口打印图像信息
     system_config.print=1;
   if((sw_sta&0x08)!=0)//BM4拨上去，使用无线模块
     system_config.wireless=1;
}
/*!
 *  @brief      main函数
 *  @since      v5.0
 *  @note       山外摄像头 LCD 测试实验
 */
int flag(double a)
{
	if(a>=0)
	{
		return 1;
	}
	else
	{
		return -1;
	}
}
void insert(int a[],int n,int val)
{
  for(int i=0;i<n;i++)
  {
    a[i+1]=a[i];
  }
  a[0]=val;
}
void  main(void)
{
   
   MotorInit();//电机控制初始化
   MotorPower (0);
   Motor2Power(0);
   //SpeedPid初始化
   PID_SetParameter(&SpeedPid,0.8,0.25,0.0,0.08);
   //PID_SetTargetValue(&SpeedPid, 150);
   PID_SetParameter(&SpeedPid2,0.8,0.25,0.0,0.08);
   //PID_SetTargetValue(&SpeedPid2, 150);
   //PID_Init(&SpeedPid, 100);
   
   

   OLED_Init();//OLED初始化
   
   systick_timing_ms(100);                                     //初始化滴答定时器，定时时间为： 100ms
   set_vector_handler(SysTick_VECTORn ,SysTick_IRQHandler);    //设置滴答定时器的中断服务函数为 SysTick_IRQHandler
   bm_switch_init();
   get_system_config();
   
  // #if defined( CAMERA_ON )
   if(system_config.camera==1)
   {
      //display_logo();//开机显示欢迎画面
      //====================摄像头与LCD的初始化程序===============================
       Site_t site     = {0, 0};                           //显示图像左上角位置
       LCD_init();
       LCD_str            (site,"Cam init ing",FCOLOUR,BCOLOUR);

       size.H = CAMERA_H;
       size.W = CAMERA_W;

       camera_init(imgbuff);

       LCD_str            (site,"Cam init OK!",FCOLOUR,BCOLOUR);
       site.y = 110;
       LCD_FSTR_CH(site,vcan_str,FCOLOUR,BCOLOUR);

   }
    //配置中断服务函数
    set_vector_handler(PORTA_VECTORn , PORTA_IRQHandler);   //设置 PORTA 的中断服务函数为 PORTA_IRQHandler
    set_vector_handler(DMA0_VECTORn , DMA0_IRQHandler);     //设置 DMA0 的中断服务函数为 PORTA_IRQHandler
    site.y = 0;
   //=======================================================================
//============================= All System Initialize ==================================//
    //---------------初始化定时器--------------------------------------------------------
    pit_init_ms(PIT0, 1);//定时时间1毫秒
    set_vector_handler(PIT0_VECTORn ,PIT0_IRQHandler);//设置PIT0的中断服务函数为 PIT0_IRQHandler
	
    led_init(LED_MAX);//初始化LED0
    key_init(KEY_MAX);
	
	
	
    BuzzerInit();//蜂鸣器初始化
    ServMotorInit();//舵机初始化
    EncoderInit();//编码器初始化
//    

//    
    enable_irq (PIT0_IRQn); //使能PIT0中断
    
    set_serv();//舵机输出
    
    uart_init (VCAN_PORT, VCAN_BAUD);   //初始化printf用到的管脚
    //printf("hello\r\n");
    init_sensor();
   //====================================================================================
    while(1)
    {   
     
        if(TimeFlag1S==1)//1S间隔运行
        {           
          TimeFlag1S=0;//清除计时标志位
		   
         
         
         //gpio_turn(PTA17);//蜂鸣器
          
         //LCD_clear(0);
          
        }
        if(TimeFlag100ms==1)//100ms间隔运行
        {
         	var1=sen_var[0] ;
    		var2=sen_var[1] ;
    		var3=sen_var[2] ;
    		var4=sen_var[3] ;
        		//printf("ch1=%d,ch2=%d,ch3=%d,ch4=%d\n",var1,var2,var3,var4);
				
			//if((var1>=190&&var2>=190&&var4>=190)||(var1>=190&&var2>=190&&var3>=190))
			//{
		//		led_turn(LED3);
		//	}
			
		 if(circle==1&&TurnAngle>=-10)
                {
                  led(LED3,LED_ON);
                }
		
		 OLED_process();
         TimeFlag100ms=0;//清除计时标志位
         
         
         
          imgCount++;
          strSite.y=0;
          strSite.x=81;
          
		  LCD_num(strSite, imgCount, FCOLOUR, BCOLOUR); 
         if(system_config.camera==1)
         {
           ImageAnalyze();
           //if(system_config.print==1)//需要通过串口输出
            //vcan_sendimg(img, sizeof(img));
         }
          led_turn(LED1);

         /*if(abs(Speed)>150&abs(Speed2)>150)
       {
          MotorPower(-1 );
          Motor2Power(1 );
       }
       else if(abs(Speed)<30&&abs(Speed2)<30)
       {
         MotorPower(50 );
          Motor2Power(-50 );
       }
       else
       {
         if(TurnAngle<5)
         {
           TestSpeed=50;
           MotorPower(TestSpeed );
           Motor2Power(-TestSpeed );
           
          }
         else
           {
             TestSpeed=20;
             MotorPower(TestSpeed + MotorDiff);
             Motor2Power(-TestSpeed + MotorDiff);
           }
         
       }*/
          
         
         
        }
        if(TimeFlag50ms==1)//50ms间隔运行
        {
          TimeFlag50ms=0;//清除计时标志位
          
        }
        if(TimeFlag20ms==1)//20ms间隔运行
        {
          TimeFlag20ms=0;//清除计时标志位

//          imgCount++;
//          strSite.y=0;
//          strSite.x=81;
//          
//		  LCD_num(strSite, imgCount, FCOLOUR, BCOLOUR); 
//         if(system_config.camera==1)
//         {
//           ImageAnalyze();
//           if(system_config.print==1)//需要通过串口输出
  //          vcan_sendimg(imgbuff, sizeof(imgbuff));
       //  }
       //   led_turn(LED1);
        }
        if(TimeFlag10ms==1)//10ms间隔运行
        {
          /*如下为测试舵机代码 变速转 */
//          ServoPulse+=10;
//            if(ServoPulse>1700)
             // ServoPulse=1520;
  		  key_msg_process();
          TimeFlag10ms=0;//清除计时标志位
		   get_sensor_val();//采集传感器电压
		

                PID_SetTargetValue(&SpeedPid,  40);
		PID_SetTargetValue(&SpeedPid2, 40);
		int outpower=0,outpower2=0;  
                if(circle==1&&TurnAngle>=-10)
                {
                  led(LED3,LED_ON);
                  Turn(-140+1520);
                  MotorPower(10);
                  Motor2Power(10);
                  circle++; 
                  PID_SetTargetValue(&SpeedPid, 40-abs(motordiff));
		  PID_SetTargetValue(&SpeedPid2, 40+(0.2*abs(motordiff)));
                  DELAY_MS(750);
                }
		
                if(circle==0&&((var1>=180&&var2>=180&&var4>=180)||(var1>=180&&var2>=180&&var3>=180)||(var1>=250)||(var2>=250)||(var4>=250)))
			{
				  Turn(-120+1520);
                                  MotorPower(10);
                                  Motor2Power(10);
                                  circle++; 
                                  PID_SetTargetValue(&SpeedPid, 40-abs(motordiff));
				  PID_SetTargetValue(&SpeedPid2, 40+(0.2*abs(motordiff)));
                                  DELAY_MS(750);
                                  MotorPower(5);
                                  Motor2Power(5);
                                 
			}
                else if((var1>=190&&var2>=190&&var4>=190&&circle==1)||(var1>=190&&var2>=190&&var3>=190&&circle==1))
                {  
                  circle++;
                }
                 else
	       {
			if((TurnAngle>60||kNear>10||abs(kFar)>10))
			{
                          // printf("2");
				if(motordiff>=0)
				{
					PID_SetTargetValue(&SpeedPid, 110-abs(motordiff));
					PID_SetTargetValue(&SpeedPid2, 110+(0.3*abs(motordiff)));
				}
				else 
				{
					PID_SetTargetValue(&SpeedPid,110+(0.3*abs(motordiff)));
					PID_SetTargetValue(&SpeedPid2, 110-abs(motordiff));
				}
			}
			else
			{
                            //printf("1");
                            PID_SetTargetValue(&SpeedPid,  180);
			    PID_SetTargetValue(&SpeedPid2, 180);
                          
			}
                  }
                outpower=PID_IncCalculate(&SpeedPid, Speed);
                setpower=setpower+(outpower/5);
                outpower2=PID_IncCalculate(&SpeedPid2, Speed2);
                setpower2=setpower2+(outpower2/5);
                setpower=PID_OutputLimit(&SpeedPid, setpower,40 , -40 );
                setpower2=PID_OutputLimit(&SpeedPid2, setpower2,40 , -40 );
                 MotorPower(setpower);
                 Motor2Power(setpower2);
    		//printf("setpower=%d  setpower2=%d\n",setpower,setpower2);
                 
    //printf("% .3f\t -- \t%.3f\t -- ",lastError,prevError);
    		
          
        }
        if(TimeFlag1ms==1)//1ms间隔运行
        {
          TimeFlag1ms=0;//清除计时标志位
		  
          
        }
		
    }

}



/*!
 *  @brief      PORTA中断服务函数
 *  @since      v5.0
 */
void PORTA_IRQHandler()
{
    uint8  n;    //引脚号
    uint32 flag;

    while(!PORTA_ISFR);
    flag = PORTA_ISFR;
    PORTA_ISFR  = ~0;                                   //清中断标志位

    n = 29;                                             //场中断
    if(flag & (1 << n))                                 //PTA29触发中断
    {
        camera_vsync();
    }
#if ( CAMERA_USE_HREF == 1 )                            //使用行中断
    n = 28;
    if(flag & (1 << n))                                 //PTA28触发中断
    {
        camera_href();
    }
#endif


}


/*!
 *  @brief      滴答定时器SysTick中断服务函数
 *  @since      v5.0
 */
void SysTick_IRQHandler(void)
{
  	
    //led_turn(LED2);             //闪烁 LED0
}


/*!
 *  @brief      DMA0中断服务函数
 *  @since      v5.0
 */
void DMA0_IRQHandler()
{
    camera_dma();
}

/*! 
 *  @brief      PIT0中断服务函数
 *  @since      v5.0
 */
void PIT0_IRQHandler(void)
{
    PITirqCount++;//累计标志
    TimeFlag1ms=1;//置位1ms标志位
    if(PITirqCount%10==0)
    {
        key_IRQHandler();                           //把按键扫描程序加入到定时中断复位函数里，定时执行
        TimeFlag10ms=1;//置位10ms标志位
    }
    if(PITirqCount%20==0)
    {
        TimeFlag20ms=1;//置位20ms标志位
       gpio_set(PTE5,0);      //舵机引脚置为1 由于电路增加了三极管驱动电路，输出会反相，故设置为0
       set_serv();//舵机输出
        //--------------测量速度------------------
       Speed=-ftm_quad_get(FTM1);
       ftm_quad_clean(FTM1);
       Speed2=ftm_quad_get(FTM2);
       ftm_quad_clean(FTM2);
       
       
        //----------------------------------------
    }
    if(PITirqCount%50==0)
    {
        TimeFlag50ms=1;//置位50ms标志位
    }
    if(PITirqCount%100==0)
    {
        TimeFlag100ms=1;//置位100ms标志位
    }
    if(PITirqCount>=1000)
    {
        TimeFlag1S=1;//置位1S标志位
        TimeUsed++;
        PITirqCount=0;//累计标志清零
        led_turn(LED0);             //闪烁 LED0
    }
   
         //蜂鸣器计时程序
         if(BuzzerCount >1)
         {
           BuzzerCount--;
         }
         else if(BuzzerCount==1)
         {
             BuzzerCount--;
             gpio_set(PTA17,1);              
         }
    
    PIT_Flag_Clear(PIT0);       //清中断标志位
}

/*! 
 *  @brief      PIT1中断服务函数
 *  @since      v5.0
 */
void PIT1_IRQHandler(void)
{
    gpio_set(PTE5,1);      //舵机引脚置为0  由于电路增加了三极管驱动电路，输出会反相，故设置为1   
    PIT_Flag_Clear(PIT1);       //清中断标志位
}


//----------------------电机相关程序-------------------------//
void MotorInit()
{
  // 马达端口使用一个PWM A6 和一个IO A8
  //  PORT_cfg.h中有上述端口定义
   ftm_pwm_init(FTM0, FTM_CH2,10000,50);//初始化FTM0CH3，频率10k,占空比0。精度为1000u
   ftm_pwm_init(FTM0, FTM_CH3,10000,50);//初始化FTM0CH3，频率10k,占空比0。精度为1000u
   gpio_init(PTA7,GPO,50);
   gpio_init(PTA8,GPO,50);
}

void MotorPower(int Power)
{
    if(Power>=0)//正转的情况
    {
        if(Power>100)//限幅
        {
            Power=100;
        }
        gpio_set(PTA7,0);
        ftm_pwm_duty(FTM0,FTM_CH2,Power);
    }
    else//反转的情况
    {
        Power=100+Power;
        if(Power>100)//限幅
        {
            Power=100;
        }
        gpio_set(PTA7,1);
        ftm_pwm_duty(FTM0,FTM_CH2,Power);
    }
}
void Motor2Power(int Power)
{
    if(Power>=0)//正转的情况
    {
        if(Power>100)//限幅
        {
            Power=100;
        }
        gpio_set(PTA8,0);
        ftm_pwm_duty(FTM0,FTM_CH3,Power);
    }
    else//反转的情况
    {
        Power=100+Power;
        if(Power>100)//限幅
        {
            Power=100;
        }
        gpio_set(PTA8,1);
        ftm_pwm_duty(FTM0,FTM_CH3,Power);
    }
}
void SpeedControl()
{
  
}

//----------------------------------------------------------//

//---------------------舵机相关程序-------------------------//
void ServMotorInit()
{
    //舵机端口使用一个PWM  E5 ，为FTM3CH0
    //ftm_pwm_init(FTM3, FTM_CH0,100,0);//初始化FTM3CH0，频率100,占空比0。精度为10000u,在.h文件中修改精度。
  gpio_init(PTE5,GPO,1);
}

void set_serv(void)
{
    pit_init_us(PIT1, ServoPulse);//舵机高电平时间 范围0-3ms
    set_vector_handler(PIT1_VECTORn ,PIT1_IRQHandler);//设置PIT1的中断服务函数为 PIT1_IRQHandler
    enable_irq (PIT1_IRQn); //使能PIT1中断
}

static int ServMid=1520;//常量表示舵机中值 1500us 需根据实际情况修改
static int RightLimit=1660;//舵机右转极限 3000us 需根据实际情况修改
static int LeftLimit=1380;//舵机左转极限 500us 需根据实际情况修改
void Turn(int n)//通过参数n控制舵机转向值
{
    //限幅
    if(n>RightLimit)
    {
        n=RightLimit;
    }
    else if(n<LeftLimit)
    {
        n=LeftLimit;
    }
    ServoPulse=n;
    
    //改变PWM
  // ftm_pwm_duty(FTM3,FTM_CH0,n+ServMid);
}
//---------------------------------------------------------//


//---------------------编码器相关程序-------------------------//
void EncoderInit()
{
    //编码器初始化，使用FTM1正交解码，端口PTA12和A13
    ftm_quad_init(FTM1);
    //编码器初始化，使用FTM2正交解码，端口PTA10和A11
    ftm_quad_init(FTM2);
    //读取速度放在定时器中断程序中
}
//---------------------------------------------------------//


//---------------------蜂鸣器相关程序-------------------------//
void BuzzerInit()
{
    //蜂鸣器初始化，使用IO口A17
    gpio_init(PTA17,GPO,1);
}
void Buzzer(int n)
{
    //蜂鸣器控制程序，输入n控制蜂鸣器的时间
    BuzzerCount=n;
 //   gpio_set(PTA17,0);
}
//---------------------------------------------------------//






//在OLED上显示图像
void show_pic_on_oled(void)
{
  OLED_Img_gray_Z(site, size, img, imgsize);
}


//-------------------图像处理部分---------------------------


//梯形校正对应关系定义
uint8 MapJ[60][80]={
1,2,3,4,5,6,7,8,9,10,11,12,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255,
255,1,2,3,4,5,6,7,8,9,10,11,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255,
255,0,1,2,3,4,5,7,8,9,10,11,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255,
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255,255,255,255,255,255,255,255,255,255,255,255,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255,};
//定义每一行的左右边界
uint8 LeftBorder[60]={1,2,3,3,4,4,5,5,6,6,7,8,8,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33,};
uint8 RightBorder[60]={76,76,75,75,74,74,73,73,72,72,71,71,70,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47,};

float DebugTest=0;

void ImageAnalyze()
{
    camera_get_img();                                   //摄像头获取图像    10秒钟能获取520帧左右
    //LCD_Img_Binary_Z(site, size, imgbuff, imgsize);
    //imgCount++;
    //LCD_num(strSite, imgCount, FCOLOUR, BCOLOUR);
    img_extract(img, imgbuff, CAMERA_SIZE);          //解压
    
    //变量定义
    uint8 Width=CAMERA_W, Height=CAMERA_H;
    
    
    //循环变量
    int ImgRow=0;//行的循环变量
    int ImgColumn=0;//列的循环变量
    
    //-----预处理：保险杠涂白------
    
    for(ImgRow=57;ImgRow<=59;ImgRow++)
    {
        for(ImgColumn=17;ImgColumn<=62;ImgColumn++)
        {
            img[ImgRow*Width+ImgColumn]=170;
        }
    }
    
    //-----------------------------
    
    //-----------------图像处理第一部分：连通域分析-------------------
    
    
    uint8 CCnum=1;//保存当前标号的变量,Connected component
    uint8 CCImage[CAMERA_H][CAMERA_W] = {0};//注意一维数组与二维数组的切换
    uint8 imgCT[CAMERA_H*CAMERA_W]={200};//梯形矫正后的图像
    uint8 CCImageCT[CAMERA_H][CAMERA_W] = {0};//梯形矫正后的连通域数组

    
    //-------------------------连通域标记----------------------------
    //最下面一行
    
    //第一列
    if(img[(Height-1)*Width] > 128)//开始就是白色
    {
      CCImage[Height-1][0]=CCnum;
      CCnum++;
    }
    //else 如果是黑色，不需要操作
    //最下面一行其他列的点
    for(ImgColumn=1;ImgColumn<Width;ImgColumn++)
    {
        if(img[(Height-1)*Width+ImgColumn] > 128)//是白色的情况，先看左侧
        {
            if(img[(Height-1)*Width+ImgColumn-1]>0)//左侧是白色，按照左侧的标号刷新
            {
              CCImage[Height-1][ImgColumn]=CCImage[Height-1][ImgColumn-1];
            }
            else//左侧是黑色，使用新标号
            {
                CCImage[Height-1][ImgColumn]=CCnum;
                CCnum++;
            }
        }
    }
    
    //其他行
    for(ImgRow=Height-2;ImgRow>=0;ImgRow--)
    {
        //第一列
        if(img[ImgRow*Width] > 128)//是白色的情况，先看下面一行
        {
            if(img[(ImgRow+1)*Width] > 128)//下面是白色，按照下面的标号刷新
            {
                CCImage[ImgRow][0]=CCImage[ImgRow+1][0];
            }
            else//下面是黑色，使用新标号
            {
                CCImage[ImgRow][0]=CCnum;
                CCnum++;                
            }
        }
        //其他列
        for(ImgColumn=1;ImgColumn<Width;ImgColumn++)
        {
            if(img[(ImgRow)*Width+ImgColumn] > 128)//是白色的情况，先看下面的点
            {
                if(img[(ImgRow+1)*Width+ImgColumn] > 128)//下面是白色，按照下面的标号刷新
                {
                    CCImage[ImgRow][ImgColumn]=CCImage[ImgRow+1][ImgColumn];
                }
                else if(img[(ImgRow)*Width+ImgColumn-1] > 128)//下面不是白色，看左侧的点。如果为白色，按照左侧的标号刷新。
                {
                    CCImage[ImgRow][ImgColumn]=CCImage[ImgRow][ImgColumn-1];
                }
                else//都不是，使用新标号
                {
                    CCImage[ImgRow][ImgColumn]=CCnum;
                    CCnum++;                
                }
            }
        }
        
        //行标号统一
        for(ImgColumn=Width-1;ImgColumn>0;ImgColumn--)
        {
            if(CCImage[ImgRow][ImgColumn]>0 && CCImage[ImgRow][ImgColumn-1]>CCImage[ImgRow][ImgColumn])//向左发现标号不一致，则左侧标号等于右侧标号
            {
                CCImage[ImgRow][ImgColumn-1]=CCImage[ImgRow][ImgColumn];
            }
        }
        for(ImgColumn=0;ImgColumn<Width-1;ImgColumn++)
        {
            if(CCImage[ImgRow][ImgColumn]>0 && CCImage[ImgRow][ImgColumn]<CCImage[ImgRow][ImgColumn+1])//向右发现标号不一致，则右侧标号等于左侧标号
            {
                CCImage[ImgRow][ImgColumn+1]=CCImage[ImgRow][ImgColumn];
            }
        }
    }
    
    //------------------------连通域标记结束--------------------------
    
    //--------------选取赛道连通域--------------------------
    
    uint8 RunwayNum=CCImage[58][39];
    
//    for(ImgRow=0;ImgRow<Height;ImgRow++)
//    {
//        for(ImgColumn=0;ImgColumn<Width;ImgColumn++)
//        {
//            
//            if(CCImage[ImgRow][ImgColumn]==RunwayNum)
//            {
//                img[ImgRow*Width+ImgColumn]=255;
//            }
//            else
//            {
//                img[ImgRow*Width+ImgColumn]=(uint8)(0.3*img[ImgRow*Width+ImgColumn]);
//            }
//          
//        }
//    }
//    
//    
    //-----------------选取结束-----------------------------
    
    //===============================梯形矫正=================================
    uint8 jCT=0;
    
    for(ImgRow=0;ImgRow<Height;ImgRow++)
    {
        for(ImgColumn=0;ImgColumn<Width;ImgColumn++)
        {
            
            jCT=MapJ[ImgRow][ImgColumn];
            
            if(jCT>80)
            {
                imgCT[ImgRow*Width+ImgColumn]=100;
            }
            else if(jCT<80)
            {
                imgCT[ImgRow*Width+ImgColumn]=img[ImgRow*Width+jCT];          //对二值化图像进行矫正
                CCImageCT[ImgRow][ImgColumn]=CCImage[ImgRow][jCT];            //对连通域图像进行矫正
            }
          
            //画网格线便于调试
            if(ImgRow%10==0 || ImgColumn%10==0)
            {
                imgCT[ImgRow*Width+ImgColumn]=200;
            }
        }
    }
    //=============================梯形矫正结束===============================
    
    //------------------------赛道分析------------------------------------
    
    //第一部分提取中线   仍旧需要从下往上扫描
    uint8 Mid[CAMERA_H]={(uint8)(Width*0.5-1)};//保存每一行中点的数组
    uint8 Left[CAMERA_H]={Width};//保存每一行左端点的数组    
    uint8 Right[CAMERA_H]={0};//保存每一行右端点的数组
    uint8 RowWidth[CAMERA_H]={0};//保存每一行赛道宽度的数组
    uint8 Top=Height;//保存最上一行赛道的行号
    
    uint8 LostLineCount=0;
    
    int SumMid=0;//累计所有行的中点值
    
    for(ImgRow=Height-1;ImgRow>=0;ImgRow--)
    {
        Left[ImgRow]=Width;
        for(ImgColumn=1;ImgColumn<Width-1;ImgColumn++)
        {
            if(CCImageCT[ImgRow][ImgColumn]==RunwayNum)
            {
                //更新行号
                if(ImgRow<Top)
                {
                  Top=ImgRow;
                }
                if(ImgColumn<Left[ImgRow])
                {
                    Left[ImgRow]=ImgColumn;//找到左端点
                }
                if(ImgColumn>Right[ImgRow])
                {
                    Right[ImgRow]=ImgColumn;//找到右端点
                }
                RowWidth[ImgRow]++;//累积赛道宽度
            }
        }
        if(RowWidth[ImgRow]>0)//本行存在赛道
        {
            //丢线判断
            if(Left[ImgRow]<=LeftBorder[ImgRow] && Right[ImgRow]<RightBorder[ImgRow] && ImgRow<Height-15)//左侧出现丢线情况
            {
                //左侧丢线，根据上一行的宽度计算本行宽度，然后根据右侧端点计算左侧端点
                RowWidth[ImgRow]=RowWidth[ImgRow+1];
                Left[ImgRow]=Right[ImgRow]-RowWidth[ImgRow]+1;
                
                //丢线累计-1
                if(ImgRow<35)
                {
                    LostLineCount--;
                }
                
                //根据右侧端点和宽度计算中点
                Mid[ImgRow]=(uint8)(Right[ImgRow]-(0.7)*RowWidth[ImgRow]+0.5);
                
                imgCT[ImgRow*Width+Mid[ImgRow]]=30;//画中线
              
            }
            else if(Left[ImgRow]>LeftBorder[ImgRow] && Right[ImgRow]>=RightBorder[ImgRow] && ImgRow<Height-15)//右侧出现丢线情况)
            {   
                //右侧丢线，根据上一行的宽度计算本行宽度，然后根据左侧端点计算右侧端点
                RowWidth[ImgRow]=RowWidth[ImgRow+1];
                Right[ImgRow]=Left[ImgRow]+RowWidth[ImgRow]-1;
                
                //丢线累计+1
                if(ImgRow<35)
                {
                    LostLineCount++;
                }
                
                //根据左侧端点和宽度计算中点
                Mid[ImgRow]=(uint8)(Left[ImgRow]+(0.7)*RowWidth[ImgRow]+0.5);
                
                imgCT[ImgRow*Width+Mid[ImgRow]]=150;//画中线
              
            }
            else//第一行或者未丢线或者两侧均丢线情况
            {
                Mid[ImgRow]=(uint8)(0.5*(Left[ImgRow]+Right[ImgRow])+0.5);//计算中点
                imgCT[ImgRow*Width+Mid[ImgRow]]=150;//画中线
            }
              
            //imgCT[ImgRow*Width+Mid[ImgRow]]=100;//画中线
            imgCT[ImgRow*Width+Left[ImgRow]]=70;//画左边缘
            imgCT[ImgRow*Width+Right[ImgRow]]=70;//画右边缘
            
            if(ImgRow>19)//小于20行的部分不采用，太不可靠
            {
                SumMid=SumMid+Mid[ImgRow]-39;//累计中点坐标值与摄像头中线的差值
            }
        }
        
    }
    
    float AverageMid=SumMid*1.0/(Height-Top+1.0);//计算偏差的平均值
    
    //-------------画中线完毕-----------------
    
    //计算曲率,两点法
    //仅有一点非常不可靠，取远中近三处计算3个K
    
    //远处的Ｋ
    
    int LengthAB=0;
    int LengthBC=0;
    
    //float kFar=0;//远处的曲率结果
    
    if(Top<15)//15行以内有赛道，取第15行的中点
    {
        LengthAB=45;
        LengthBC=(int)(0.33333*(Mid[15]+Mid[14]+Mid[16]-117));//3行取平均
    }
    else//15行以内无赛道，根据Top值计算
    {
        LengthAB=Height-(Top+2);
        LengthBC=(int)(0.33333*(Mid[Top+1]+Mid[Top+2]+Mid[Top+3]-117));
    }
    
    kFar=1000*(2.0*LengthBC)/(1.0*(LengthAB*LengthAB+LengthBC*LengthBC));
    //K乘以1000大概是正负25
    
    //近处的Ｋ，取第40行的进行计算,太抖，改成第50行
    
    
    
    //显示k的结果，换成整形，乘以1000
    LengthAB=10;
    LengthBC=(int)(0.2*(Mid[48]+Mid[50]+Mid[52]+Mid[49]+Mid[51]-195));//5行取平均
    kNear=1000*(2.0*LengthBC)/(1.0*(LengthAB*LengthAB+LengthBC*LengthBC));
    
    
    //中间处的K，取Mid值的平均偏差
    float kAverage=0;
    
    //显示k的结果，换成整形，乘以1000
    LengthAB=(int)(0.5*(Height-Top+1.5));
    kAverage=1000*(2.0*AverageMid)/(1.0*(LengthAB*LengthAB+AverageMid*AverageMid));
    //printf("kfar=%f,kaverage=%f,knear=%f\n",kFar,kAverage,kNear);
    //DebugTest=kAverage;
    
    //显示3个K值在屏幕上
    
    int IK=(int)(kFar);
    if(IK>0)
    {
    
      strSite.x=0;
      strSite.y=70;
      
      LCD_num(strSite, IK, FCOLOUR, BCOLOUR); //负数显示不出来。。。
      
    }
    else
    {
      strSite.x=0;
      strSite.y=86;
      
      LCD_num(strSite, IK*(-1), FCOLOUR, BCOLOUR);
    }
    IK=(int)(kAverage);
    if(IK>0)
    {
    
      strSite.x=40;
      strSite.y=70;
      
      LCD_num(strSite, IK, FCOLOUR, BCOLOUR); //负数显示不出来。。。
      
    }
    else
    {
      strSite.x=40;
      strSite.y=86;
      
      LCD_num(strSite, IK*(-1), FCOLOUR, BCOLOUR);
    }
        
    IK=(int)(kNear);
    if(IK>0)
    {
    
      strSite.x=81;
      strSite.y=70;
      
      LCD_num(strSite, IK, FCOLOUR, BCOLOUR); //负数显示不出来。。。
      
    }
    else
    {
      strSite.x=81;
      strSite.y=86;
      
      LCD_num(strSite, IK*(-1), FCOLOUR, BCOLOUR);
    }
    kFar*=1.15;
    kAverage*=1.2;
    //根据加权平均后的曲率值来计算转向值
    //int TurnError=0;
	/*if(lastkFar != 0)
	{
		lastkFar = kFar;
	}*/
	TurnError=(int)(TurnP*(0.25*kFar+0.50*kAverage+0.7*kNear));
	/*if(kAverage - kNear >= 30)
	{
	  if(kFar*kAverage>=10)
	  {
		  TurnError=(int)(TurnP*(0.3*kFar+0.5*kAverage+0.3*kNear));
	  }
	  else if(kFar*kAverage<10 && kFar*kAverage>-10)
	  {
		  TurnError=(int)(TurnP*(0.1*kFar+0.4*kAverage+0.6*kNear));
	  }
	  else
	  {
		  TurnError=(int)(TurnP*(0.2*kFar+0.4*kAverage+0.3*kNear));
	  }
	}
	else if(kAverage - kNear < 30 && kAverage - kNear > -30)
	{
		if(kFar*kAverage>=10)
	  {
		  TurnError=(int)(TurnP*(0.3*kFar+0.45*kAverage+0.35*kNear));
	  }
	  else if(kFar*kAverage<10 && kFar*kAverage>-10)
	  {
		  TurnError=(int)(TurnP*(0.3*kFar+0.4*kAverage+0.4*kNear));
	  }
	  else
	  {
		  TurnError=(int)(TurnP*(0.2*kFar+0.45*kAverage+0.35*kNear));
	  }
	}
	else 
	{
		if(kFar*kAverage>=10)
	  {
		  TurnError=(int)(TurnP*(0.3*kFar+0.4*kAverage+0.4*kNear));
	  }
	  else
	  {
		  TurnError=(int)(TurnP*(0.2*kFar+0.5*kAverage+0.4*kNear));
	  }
	}*/
    
    
    ////////////////////////////////////////////////////////////////////////////////////////////////////////
    //////转向控制 2019.10.30测试时暂时屏蔽 后续需取消屏蔽
	
			/*int outpower=0;
			PID_SetTargetValue(&SpeedPid, 150);
			outpower=PID_IncCalculate(&SpeedPid, (abs(Speed2)));
			outpower=PID_OutputLimit(&SpeedPid, outpower,10 ,-10);
			setpower=setpower+outpower;
			MotorPower(setpower);
             Motor2Power(setpower);*/

   double nowError = 0 + TurnError + TurnAngle;
    double pError, dError, iError; 
    float KI;
    
	pError = nowError - lastError;
	iError = nowError;
	dError = nowError - 2*(lastError) + prevError;
	
	KI = ki * (1 - abs(tanh(6*(nowError / kc)))); 
	
    double out = kp * pError +\
                       KI * iError +\
                 kd * dError;
	TurnAngle = TurnAngle - (out);
	motordiff = out/2.5;
    if(motordiff>=15)
	{
		motordiff = 15;
	}
    else if(motordiff<=-15)
	{
		motordiff = -15;
	}
	if (TurnAngle < -140) 
	{
        TurnAngle = -140;
    } 
	else if (TurnAngle > 140) 
	{
        TurnAngle = 140;
    }
	 /*if(abs(Speed)>180&abs(Speed2)>180)
       {
          MotorPower(-2 );
          Motor2Power(2 );
       }
       else if(abs(Speed)<25&&abs(Speed2)<25)
       {
         MotorPower(50 );
          Motor2Power(-50 );
       }
       else
       {
         if(abs(TurnAngle)<25)
         {
           TestSpeed=40;
           MotorPower(TestSpeed );
           Motor2Power(-TestSpeed );
           
          }
         else
           {
             TestSpeed=20;
             MotorPower(TestSpeed + MotorDiff);
             Motor2Power(-TestSpeed + MotorDiff);
           }
	   }*/
                 
    //printf("% .3f\t -- \t%.3f\t -- ",lastError,prevError);
    prevError = lastError;
    lastError = nowError;
	
	//MotorDiff = out / 50;
	/*if(out>0)
	{
	MotorPower (28 );
	Motor2Power(-28-out);
	}
	else if(out<0)
	{
	MotorPower (28-out);
	Motor2Power(-28);
	}*/
    Turn(TurnAngle+1520);
    //Turn(ServMid);
    
//高亮赛道连通域
    for(ImgRow=0;ImgRow<Height;ImgRow++)
    {
        for(ImgColumn=0;ImgColumn<Width;ImgColumn++)
        {
            
            if(CCImageCT[ImgRow][ImgColumn]==RunwayNum)
            {
                imgCT[ImgRow*Width+ImgColumn]=255;
            }
            else
            {
                imgCT[ImgRow*Width+ImgColumn]=(uint8)(0.3*imgCT[ImgRow*Width+ImgColumn]);
            }
            if(ImgRow==Top)
            {
                imgCT[ImgRow*Width+ImgColumn]=100;
            }
            imgCT[ImgRow*Width+Mid[ImgRow]]=180;//画中线
          
        }
    }
    
    
    //----------------------赛道分析结束----------------------------------
    
    
    //将连通域显示出来
//    for(ImgRow=0;ImgRow<Height;ImgRow++)
//    {
//      for(ImgColumn=0;ImgColumn<Width;ImgColumn++)
//      {
//          img[ImgRow*Width+ImgColumn]=CCImage[ImgRow][ImgColumn];
//      }
//    }
      
//    LCD_Img_gray_Z(site, size, img, imgsize);
    
    
}








